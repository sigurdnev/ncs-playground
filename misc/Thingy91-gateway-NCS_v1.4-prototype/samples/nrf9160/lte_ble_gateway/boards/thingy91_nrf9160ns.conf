## misc/Thingy91-gateway-NCS_v1.4-prototype/samples/nrf9160/lte_ble_gateway/boards/thingy91_nrf9160ns.conf
```kconfig
CONFIG_NRF_SW_LPUART=y
CONFIG_NRF_SW_LPUART_INT_DRIVEN=y

CONFIG_UART_1_ASYNC=y
CONFIG_UART_1_INTERRUPT_DRIVEN=n
CONFIG_UART_1_NRF_HW_ASYNC=y
CONFIG_UART_1_NRF_HW_ASYNC_TIMER=2
```
